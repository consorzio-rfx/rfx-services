## Kconfig
```kconfig
# ////////////////////////////////////////////////////////////////////////// //
#
# This file is part of the autoconf-bootstrap project.
# Copyright 2018 Andrea Rigoni Garola <andrea.rigoni@igi.cnr.it>.
#
# This program is free software: you can redistribute it and/or modify
# it under the terms of the GNU General Public License as published by
# the Free Software Foundation, either version 3 of the License, or
# (at your option) any later version.
#
# This program is distributed in the hope that it will be useful,
# but WITHOUT ANY WARRANTY; without even the implied warranty of
# MERCHANTABILITY or FITNESS FOR A PARTICULAR PURPOSE.  See the
# GNU General Public License for more details.
#
# You should have received a copy of the GNU General Public License
# along with this program.  If not, see <http://www.gnu.org/licenses/>.
#
# ////////////////////////////////////////////////////////////////////////// //



#
# For a description of the syntax of this configuration file,
# see Documentation/kbuild/kconfig-language.txt.
#
mainmenu "RFX service manager"


# //////////////////////////////////////////////////////////////////////////// #
# //  BUILD_COMMON  ////////////////////////////////////////////////////////// #
# //////////////////////////////////////////////////////////////////////////// #

  source conf/kscripts/build_common.kconfig


# comment "RFX services"

# ////////////////////////////////////////////////////////////////////////////////
# //  SERVICES  //////////////////////////////////////////////////////////////////
# ////////////////////////////////////////////////////////////////////////////////

  source services/docker_services.kconfig
```
